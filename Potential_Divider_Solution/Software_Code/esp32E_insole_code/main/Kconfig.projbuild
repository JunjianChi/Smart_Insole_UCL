## Potential_Divider_Solution/Software_Code/esp32E_insole_code/main/Kconfig.projbuild
```kconfig
menu "Custom Configuration"

    choice SENSOR_TYPE
        prompt "Sensor Type"
        default MAT_SENSOR
        help
            Select the type of sensor being used in the application.

        config INSOLE_SENSOR
            bool "Insole Sensor"
            help
                Select this option if you are using an insole sensor.

        config MAT_SENSOR
            bool "Mat Sensor"
            help
                Select this option if you are using a mat sensor.
    endchoice

    choice DATA_ENCODE
        prompt "Data Encoding"
        default DATA_ENCODE_ASCII
        help
            Select the encoding format for the data being sent.

        config DATA_ENCODE_ASCII
            bool "ASCII"
            help
                Select this option to encode the data in ASCII format.

        config DATA_ENCODE_RAW
            bool "RAW"
            help
                Select this option to encode the data in RAW format.
    endchoice

    choice DATA_PACKAGE
        prompt "Data Package"
        default DATA_PACKAGE_COLUMN
        help
            Select the package format for the data being sent.

        config DATA_PACKAGE_FRAME
            bool "Frame"
            help
                Select this option to package the data in frame format.

        config DATA_PACKAGE_COLUMN
            bool "Column"
            help
                Select this option to package the data in column format.
    endchoice

    config SENSOR_COL_SIZE
        int "Sensor Column Size"
        default 32
        help
            Set the number of columns in the sensor matrix.

    config SENSOR_ROW_SIZE
        int "Sensor Row Size"
        default 32
        help
            Set the number of rows in the sensor matrix.

    menu "ADC Configuration"
        config ADC_CHANNEL
            int "ADC Channel"
            default 0
            help
                Set the ADC channel number.

        config ADC_RESOLUTION
            int "ADC Resolution"
            default 12
            help
                Set the ADC resolution.

        config ADC_AVERAGE_NUM
            int "ADC Average Number"
            default 10
            help
                Set the number of ADC samples to average.
    endmenu

    menu "Pin Configuration"
        config WR01
            int "WR01 Pin"
            default 26
            help
                Set the pin number for WR01.
    
        config WR02
            int "WR02 Pin"
            default 27
            help
                Set the pin number for WR02.
    
        config A0
            int "A0 Pin"
            default 25
            help
                Set the pin number for A0.
    
        config A1
            int "A1 Pin"
            default 33
            help
                Set the pin number for A1.
    
        config A2
            int "A2 Pin"
            default 32
            help
                Set the pin number for A2.
    
        config A3
            int "A3 Pin"
            default 16
            help
                Set the pin number for A3.
    
        config A4
            int "A4 Pin"
            default 4
            help
                Set the pin number for A4.

    endmenu


    menu "WiFi Configuration"
        config WIFI_SSID
            string "WiFi SSID"
            default "dd-wrt"
            help
                Set the SSID of the WiFi network to connect to.

        config WIFI_PASS
            string "WiFi Password"
            default "0000000000"
            help
                Set the password of the WiFi network to connect to.

        config SERVICE_ADDRESS
            string "Service Address"
            default "192.168.137.1"
            help
                Set the IP address for the server.

        config SERVICE_PORT
            int "Service Port"
            default 4444
            help
                Set the port number for the server.
    endmenu

endmenu
```
